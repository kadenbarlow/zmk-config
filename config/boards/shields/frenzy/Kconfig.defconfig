## config/boards/shields/frenzy/Kconfig.defconfig
```kconfig
# Copyright (c) 2020 The ZMK Contributors
# SPDX-License-Identifier: MIT
 
 
if SHIELD_FRENZY_LEFT

config ZMK_KEYBOARD_NAME
	default "Frenzy"

config ZMK_SPLIT_ROLE_CENTRAL
	default y

endif

if SHIELD_FRENZY_LEFT || SHIELD_FRENZY_RIGHT

config ZMK_SPLIT
	default y

endif
```

## config/boards/shields/frenzy/Kconfig.shield
```kconfig
# Copyright (c) 2020 The ZMK Contributors
# SPDX-License-Identifier: MIT

config SHIELD_FRENZY_LEFT
	def_bool $(shields_list_contains,frenzy_left)

config SHIELD_FRENZY_RIGHT
	def_bool $(shields_list_contains,frenzy_right)
```
